## sdkconfig.defaults
```kconfig
# SUMI E-Reader SDK Configuration Defaults
# This file is used by ESP-IDF to override default configurations

# Arduino loop task stack size - 32KB for deep EPUB parsing call stacks
CONFIG_ARDUINO_LOOP_STACK_SIZE=32768
CONFIG_FREERTOS_IDLE_TASK_STACKSIZE=4096
CONFIG_MAIN_TASK_STACK_SIZE=8192

# Main task stack
CONFIG_ESP_MAIN_TASK_STACK_SIZE=8192

# Wi-Fi buffer configuration
CONFIG_ESP_WIFI_STATIC_RX_BUFFER_NUM=4
CONFIG_ESP_WIFI_DYNAMIC_RX_BUFFER_NUM=8
CONFIG_ESP_WIFI_DYNAMIC_TX_BUFFER_NUM=8
```
